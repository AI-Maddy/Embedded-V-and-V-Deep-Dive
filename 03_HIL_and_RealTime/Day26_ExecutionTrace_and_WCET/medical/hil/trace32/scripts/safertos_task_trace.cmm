; HIL Medical SafeRTOS Task Trace
; Generated for reproducible V&V workflows
; Preconditions: target connected, symbols available, trace buffers cleared
PRINT "----------------------------------------"
PRINT "HIL Medical SafeRTOS Task Trace"
PRINT "----------------------------------------"
SYStem.CPU CORTEXR5
SYStem.Mode Up
SYStem.Option RESBREAK ON
Trace.RESet
Perf.RESet
Break.Set \vTaskSwitchContext
Go
Wait 1.s
Trace.ON
Wait 2.s
Trace.OFF
Perf.List
Trace.List
Trace.METHOD Program
Break.Set \alarm_monitor_task
Data.SAVE.Binary hil_med_task_trace.bin
PRINT "Artifact exported"
PRINT "Script completed successfully"
PRINT "Quality Gate Extension"
PRINT "Domain=Medical Phase=HIL"
Break.List
Trace.STATistic ON
Trace.METHOD Program
Perf.List
Trace.List
PRINT "Ensure artifact contains nominal, boundary, fault evidence"
PRINT "Record requirement IDs and residual risk items"
PRINT "Quality Gate Extension Complete"
PRINT "Quality Gate Extension"
PRINT "Domain=Medical Phase=HIL"
Break.List
Trace.STATistic ON
Trace.METHOD Program
Perf.List
Trace.List
PRINT "Ensure artifact contains nominal, boundary, fault evidence"
PRINT "Record requirement IDs and residual risk items"
PRINT "Quality Gate Extension Complete"
PRINT "Quality Gate Extension"
PRINT "Domain=Medical Phase=HIL"
Break.List
Trace.STATistic ON
Trace.METHOD Program
Perf.List
Trace.List
PRINT "Ensure artifact contains nominal, boundary, fault evidence"
PRINT "Record requirement IDs and residual risk items"
PRINT "Quality Gate Extension Complete"
ENDDO
